## source/components/espressif__usb_host_cdc_acm/test_app/sdkconfig.defaults
```kconfig
# Configure TinyUSB, it will be used to mock USB devices
CONFIG_TINYUSB_MSC_ENABLED=n
CONFIG_TINYUSB_CDC_ENABLED=y
CONFIG_TINYUSB_CDC_COUNT=2
CONFIG_TINYUSB_HID_COUNT=0

# Disable watchdogs, they'd get triggered during unity interactive menu
# CONFIG_ESP_TASK_WDT_INIT is not set

# Register tinyusb suspend/resume callbacks in esp_tinyusb
CONFIG_TINYUSB_SUSPEND_CALLBACK=y
CONFIG_TINYUSB_RESUME_CALLBACK=y

# Run-time checks of Heap and Stack
CONFIG_COMPILER_STACK_CHECK_MODE_STRONG=y
CONFIG_COMPILER_STACK_CHECK=y

CONFIG_UNITY_ENABLE_BACKTRACE_ON_FAIL=y

CONFIG_COMPILER_CXX_EXCEPTIONS=y
```

## source/main/Kconfig.projbuild
```kconfig
menu "Tonex Controller Configuration"

    choice TONEX_CONTROLLER_HARDWARE_PLATFORM
        prompt "Tonex Controller Hardware Platform"
        default TONEX_CONTROLLER_HARDWARE_PLATFORM_WAVESHARE_43B
    
        config TONEX_CONTROLLER_HARDWARE_PLATFORM_WAVESHARE_43B
            bool "Waveshare 4.3B"

        config TONEX_CONTROLLER_HARDWARE_PLATFORM_WAVESHARE_35B
            bool "Waveshare 3.5B"

        config TONEX_CONTROLLER_HARDWARE_PLATFORM_JC3248W535
            bool "JC3248W535 3.5"

        config TONEX_CONTROLLER_HARDWARE_PLATFORM_WAVESHARE_169
            bool "Waveshare 1.69"

        config TONEX_CONTROLLER_HARDWARE_PLATFORM_WAVESHARE_169TOUCH
            bool "Waveshare 1.69 Touch"

        config TONEX_CONTROLLER_HARDWARE_PLATFORM_WAVESHARE_ZERO
            bool "Waveshare Zero"
            
        config TONEX_CONTROLLER_HARDWARE_PLATFORM_DEVKITC
            bool "Espressif DevKitC"
            
        config TONEX_CONTROLLER_HARDWARE_PLATFORM_M5ATOMS3R
            bool "M5Stack AtomS3R"   

        config TONEX_CONTROLLER_HARDWARE_PLATFORM_WAVESHARE_43DEVONLY            
            bool "Waveshare 4.3 Development board"   

        config TONEX_CONTROLLER_HARDWARE_PLATFORM_LILYGO_TDISPLAY_S3
            bool "LilyGo T-Display S3"   
        
        config TONEX_CONTROLLER_HARDWARE_PLATFORM_WAVESHARE_19TOUCH
            bool "Waveshare 1.9 Touch"

        config TONEX_CONTROLLER_HARDWARE_PLATFORM_PIRATE_MIDI_POLAR_PRO
            bool "Pirate Midi Polar Pro 1.69"

        config TONEX_CONTROLLER_HARDWARE_PLATFORM_PIRATE_MIDI_POLAR_MAX_V2
            bool "Pirate Midi Polar Max V2 3.5 touch"
            
    endchoice
    
    config TONEX_CONTROLLER_HAS_DISPLAY
       bool "LCD display is used"
        default "n"
        help
            Enable this option if the platform has a display
    
    config TONEX_CONTROLLER_HAS_TOUCH
       bool "Touch Screen is used"
        default "n"
        help
            Enable this option if the platform has a touch screen

    config TONEX_CONTROLLER_DISPLAY_SMALL
       bool "Small LCD display is used"
        default "n"
        help
            Enable this option if the platform has a small display

    config TONEX_CONTROLLER_DISPLAY_FULL_UI
       bool "Large LCD display with full user interface is used"
        default "n"
        help
            Enable this option if the platform has a large display with full UI
    
    config TONEX_CONTROLLER_GPIO_FOOTSWITCHES
       bool "Footswitches are directly connected to GPIO"
        default "y"
        help
            Enable this option if the platform has footswitches directly connected to GPIO
           
    config TONEX_CONTROLLER_DEFAULT_MIDI_ENABLE
        bool "Enable Midi by default"
        default "n"
        help
            Sets if Midi (serial) is enabled by default
         
    config TONEX_CONTROLLER_WAVESHARE_169_LANDSCAPE
        bool "Waveshare 1.69 Landscape screen"
        default "n"
        help
            Sets if the screen on the Waveshare uses Landscape mode with 90/270 degree rotation

    config TONEX_CONTROLLER_SCREEN_ROTATION_DEFAULT_180
        bool "Default 180 degree screen rotation"
        default "n"
        help
            Sets if the screen defaults to 180 degree rotation
        
    config TONEX_CONTROLLER_SHOW_BPM_INDICATOR
        bool "Show BPM flashing indicator on LCD (requires TONEX_CONTROLLER_DISPLAY_FULL_UI also)"
        default "n"
        help
            Enable this option to show BPM indicator

    config TONEX_CONTROLLER_ENABLE_MIDI_THRU
        bool "Enable Midi Thru"
        default "y"
        help
            Enable this option if the platform can support Midi Transmit
       
    choice TONEX_CONTROLLER_LED_CONTROL_MODE
        prompt "Led control mode"
        default TONEX_CONTROLLER_LED_CONTROL_DISABLED
    
        config TONEX_CONTROLLER_LED_CONTROL_DISABLED
            bool "Disabled"

        config TONEX_CONTROLLER_LED_CONTROL_BOOT_FLASH
            bool "Boot flash"
    endchoice

    choice TONEX_CONTROLLER_LED_COLOUR_ORDER
        prompt "Led colour order"
        default TONEX_CONTROLLER_LED_COLOUR_ORDER_RGB
    
        config TONEX_CONTROLLER_LED_COLOUR_ORDER_RGB
            bool "RGB"

        config TONEX_CONTROLLER_LED_COLOUR_ORDER_GBR
            bool "GBR"

        config TONEX_CONTROLLER_LED_COLOUR_ORDER_GRB
            bool "GRB"
    endchoice    
    
    config TONEX_CONTROLLER_LED_NUMBER
        int "Number of Leds"
        range 0 16
        default 0
        help
            Set the number of leds the platform has 

    choice TONEX_CONTROLLER_LED_TYPE
        prompt "Led Type"
        default TONEX_CONTROLLER_LED_WS2812
    
        config TONEX_CONTROLLER_LED_WS2812
            bool "WS2812, 0.3,0.9 usec timing"

        config TONEX_CONTROLLER_LED_SK6812
            bool "SK6812, 0.3,0.9 and 0.6,0.6 usec timing"
   
    endchoice    
            
    config EXAMPLE_DOUBLE_FB
        bool "Use double Frame Buffer"
        default "n"
        help
            Enable this option, driver will allocate two frame buffers.

    config EXAMPLE_USE_BOUNCE_BUFFER
        depends on !EXAMPLE_DOUBLE_FB
        bool "Use bounce buffer"
        help
            Enable bounce buffer mode can achieve higher PCLK frequency at the cost of higher CPU consumption.

    config EXAMPLE_AVOID_TEAR_EFFECT_WITH_SEM
        depends on !EXAMPLE_DOUBLE_FB
        bool "Avoid tearing effect"
        default "y"
        help
            Enable this option, the example will use a pair of semaphores to avoid the tearing effect.
            Note, if the Double Frame Buffer is used, then we can also avoid the tearing effect without the lock.
                     
endmenu
```
